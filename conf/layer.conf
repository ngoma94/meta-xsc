## conf/layer.conf
```bitbake
# We have a conf and classes directory, add to BBPATH
BBPATH .= ":${LAYERDIR}"

# We have recipes-* directories, add to BBFILES
BBFILES += "${LAYERDIR}/recipes-*/*/*.bb \
            ${LAYERDIR}/recipes-*/*/*.bbappend"

BBFILE_COLLECTIONS += "meta-xsc"
BBFILE_PATTERN_meta-xsc = "^${LAYERDIR}/"
BBFILE_PRIORITY_meta-xsc = "5"

LAYERDEPENDS_meta-xsc = "core"
LAYERSERIES_COMPAT_meta-xsc = "kirkstone"

MACHINE ?= "raspberrypi4"
```
